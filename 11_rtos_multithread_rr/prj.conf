## CMakeLists.txt
```
#1.Declare minimum CMake version
cmake_minimum_required(VERSION 3.20.0)
#2.Locate the zephyr build system as a CMake package
find_package(Zephyr REQUIRED HINTS $ENV{ZEPHYR_BASE})
#3.Name the CMakeLists.txt project
project(rtos_multithread_rr)
#4.Add the executable for the application, Tell zephyr which source files belong to this application
target_sources(app PRIVATE src/main.c)
```

## prj.conf
```kconfig
CONFIG_SERIAL=y
CONFIG_CONSOLE=y
CONFIG_PRINTK=y

#enable timeslicing for round-robin scheduling
CONFIG_TIMESLICING=y
#set the timeslice size to 10ms, the default is 20ms
CONFIG_TIMESLICE_SIZE=10
#Timeslice priority is set to 0, which is the lowest priority, so that it does not interfere with higher priority threads
CONFIG_TIMESLICE_PRIORITY=0
```

## src/main.c
```c
#include <zephyr/kernel.h>
#include <zephyr/sys/printk.h>

/*Define stack size in bytes*/
#define THREAD_1_STACK_SIZE 1024
#define THREAD_2_STACK_SIZE 1024

/*Define priority lower number = higher priority*/
#define THREAD_1_PRIORITY 5
#define THREAD_2_PRIORITY 5

static void thread_1_entry(void *p1, void *p2, void *p3)
{
    ARG_UNUSED(p1);
    ARG_UNUSED(p2);
    ARG_UNUSED(p3);
    while(1) {
        printk("Hello from thread 1!\n");
        k_msleep(50);
    }
}
static void thread_2_entry(void *p1, void *p2, void *p3)
{
    ARG_UNUSED(p1);
    ARG_UNUSED(p2);
    ARG_UNUSED(p3);
    while(1) {
        printk("Hello from thread 2!\n");
        k_msleep(50);
    }
}
/*Define thread*/
K_THREAD_DEFINE(
                        thread_1_tid, /*symbolic thread identifier*/
                        THREAD_1_STACK_SIZE, /*stack size in bytes*/
                        thread_1_entry, /*thread entry function*/
                        NULL, /*parameters to thread entry function*/
                        NULL, /*parameters to thread entry function*/
                        NULL, /*parameters to thread entry function*/
                        THREAD_1_PRIORITY, /*thread priority*/
                        0, /*thread options*/
                        0 /*delay before thread starts*/);
                        /*Define thread*/
K_THREAD_DEFINE(
                        thread_2_tid, /*symbolic thread identifier*/
                        THREAD_2_STACK_SIZE, /*stack size in bytes*/
                        thread_2_entry, /*thread entry function*/
                        NULL, /*parameters to thread entry function*/
                        NULL, /*parameters to thread entry function*/
                        NULL, /*parameters to thread entry function*/
                        THREAD_2_PRIORITY, /*thread priority*/
                        0, /*thread options*/
                        0 /*delay before thread starts*/);

int main()
{
    /*First start for RTOS*/
    printk("RTOS Thread demo started\n");

    while(1) {

        k_sleep(K_FOREVER);
    }

    return 0;
}
```
